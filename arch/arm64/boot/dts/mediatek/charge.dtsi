
&i2c0 {
	fuelguage@62 {
		compatible = "cellwise,cw2015";
		reg = <0x62>;
		batinfo = /bits/ 8 <0x18 0x0A 0x63 0x67 0x6A 0x69 0x69 0x67 0x62 0x60 0x64 0x58 0x69 0x58 0x47 0x41
							0x37 0x30 0x29 0x25 0x26 0x34 0x43 0x4C 0x1F 0x4B 0x0B 0x85 0x1D 0x3A 0x3D 0x4A
							0x56 0x5A 0x5A 0x5C 0x3E 0x1A 0x66 0x52 0x0B 0x1D 0x31 0x58 0x89 0x92 0x94 0x15
							0x31 0x5F 0xA0 0xBE 0x80 0x78 0xAE 0xCB 0x2F 0x00 0x64 0xA5 0xB5 0x0E 0x09 0x69>;
	};
};